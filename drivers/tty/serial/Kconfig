## drivers/tty/serial/Kconfig
```kconfig
#
# Serial device configuration
#

menu "More Serial drivers"
	depends on HAS_IOMEM

config SERIAL_PCH_UART
	tristate "Intel EG20T PCH UART"
	depends on PCI && DMADEVICES
	select SERIAL_CORE
	depends on PCI
	select PCH_DMA
	help
	  This driver is for PCH(Platform controller Hub) UART of Intel EG20T
	  which is an IOH(Input/Output Hub) for x86 embedded processor.
	  Enabling PCH_DMA, this PCH UART works as DMA mode.

	  This driver also can be used for OKI SEMICONDUCTOR ML7213 IOH(Input/
	  Output Hub) which is for IVI(In-Vehicle Infotainment) use.
	  ML7213 is companion chip for Intel Atom E6xx series.
	  ML7213 is completely compatible for Intel EG20T PCH.
endmenu
```
